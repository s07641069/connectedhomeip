## CMakeLists.txt
```
#
#    Copyright (c) 2022-2025 Project CHIP Authors
#
#    Licensed under the Apache License, Version 2.0 (the "License");
#    you may not use this file except in compliance with the License.
#    You may obtain a copy of the License at
#
#        http://www.apache.org/licenses/LICENSE-2.0
#
#    Unless required by applicable law or agreed to in writing, software
#    distributed under the License is distributed on an "AS IS" BASIS,
#    WITHOUT WARRANTIES OR CONDITIONS OF ANY KIND, either express or implied.
#    See the License for the specific language governing permissions and
#    limitations under the License.
#

cmake_minimum_required(VERSION 3.13.1)

get_filename_component(CHIP_ROOT ${CMAKE_CURRENT_SOURCE_DIR}/third_party/connectedhomeip REALPATH)
get_filename_component(TELINK_COMMON ${CHIP_ROOT}/examples/platform/telink REALPATH)
get_filename_component(GEN_DIR ${CHIP_ROOT}/zzz_generated/ REALPATH)

include(${TELINK_COMMON}/common.cmake)
include(${CHIP_ROOT}/config/telink/app/enable-gnu-std.cmake)
include(${CHIP_ROOT}/src/app/chip_data_model.cmake)

project(chip-telink-lighting-example)

target_include_directories(app PRIVATE
                           include
                           ${GEN_DIR}/app-common
                           ${GEN_DIR}/lighting-app
                           ${TELINK_COMMON}/common/include
                           ${TELINK_COMMON}/util/include
                           ${TELINK_COMMON}/app/include
                           ${TELINK_COMMON}/zephyr_ext)

if(CONFIG_TFLM_FEATURE)
  target_include_directories(app PRIVATE
                             src
                             src/tflm/micro_speech
                             src/tflm/models
                             ${ZEPHYR_BASE}/../modules/lib/tflite-micro-telink
                             ${ZEPHYR_BASE}/../modules/lib/tflite-micro-telink/third_party/ruy
                             ${ZEPHYR_BASE}/../modules/lib/tflite-micro-telink/third_party/gemmlowp
                             ${ZEPHYR_BASE}/../modules/lib/tflite-micro-telink/third_party/flatbuffers/include
                             ${ZEPHYR_BASE}/../modules/lib/tflite-micro-telink/third_party/kissfft/tools
                             ${ZEPHYR_BASE}/../modules/lib/tflite-micro-telink/third_party/kissfft)
endif()

target_sources(app PRIVATE
               src/AppTask.cpp
               src/ZclCallbacks.cpp
               ${CHIP_ROOT}/src/app/persistence/DeferredAttributePersistenceProvider.cpp
               ${TELINK_COMMON}/common/src/mainCommon.cpp
               ${TELINK_COMMON}/common/src/AppTaskCommon.cpp
               ${TELINK_COMMON}/util/src/LEDManager.cpp
               ${TELINK_COMMON}/util/src/ButtonManager.cpp
               ${TELINK_COMMON}/util/src/ThreadUtil.cpp
               ${TELINK_COMMON}/util/src/PWMManager.cpp
               ${TELINK_COMMON}/util/src/ColorFormat.cpp
               ${TELINK_COMMON}/zephyr_ext/zephyr_key_matrix.c
               ${TELINK_COMMON}/zephyr_ext/zephyr_key_pool.c
               ${TELINK_COMMON}/zephyr_ext/zephyr_led_pool.c
               ${TELINK_COMMON}/zephyr_ext/zephyr_ws2812.c)

if(CONFIG_TFLM_FEATURE)
  target_sources(app PRIVATE
                 src/tflm/audio/app_audio.c
                 src/tflm/audio/app_codec.c
                 src/tflm/audio/audio_common.c
                 src/tflm/models/audio_preprocessor_int8_model_data.cpp
                 src/tflm/models/audio_preprocessor_int8_model_data.h
                 src/tflm/models/micro_speech_quantized_model_data.cpp
                 src/tflm/models/micro_speech_quantized_model_data.h
                 src/tflm/micro_speech/micro_model_settings.h
                 src/tflm/micro_speech/tflite_micro_micro_speech.cpp
                 src/tflm/micro_speech/tflite_micro_micro_speech.h
                 src/tflm/errno_stub.c)
endif()

if(CONFIG_DeviceType_DimmableLight)
chip_configure_data_model(app
    ZAP_FILE ${CMAKE_CURRENT_SOURCE_DIR}/../lighting-common/lighting-app.zap
)
endif()

if(CONFIG_DeviceType_ColorTemperatureLight)
chip_configure_data_model(app
    INCLUDE_SERVER
    ZAP_FILE ${CMAKE_CURRENT_SOURCE_DIR}/../lighting-common/colortemperaturelight-lighting-app.zap
)
endif()

if(CONFIG_DeviceType_ExtendedColorLight)
chip_configure_data_model(app
    INCLUDE_SERVER
    ZAP_FILE ${CMAKE_CURRENT_SOURCE_DIR}/../lighting-common/extendedcolorlight-lighting-app.zap
)
endif()

if(CONFIG_PWM)
	target_sources(app PRIVATE 
                   ${TELINK_COMMON}/zephyr_ext/zephyr_pwm_pool.c)
endif()

if(CONFIG_BOOTLOADER_MCUBOOT)
  target_sources(app PRIVATE ${TELINK_COMMON}/util/src/OTAUtil.cpp)
endif()

if(CONFIG_MCUMGR_TRANSPORT_BT)
    zephyr_library_link_libraries(MCUBOOT_BOOTUTIL)
    target_sources(app PRIVATE ${TELINK_COMMON}/util/src/DFUOverSMP.cpp)
endif()

if (CONFIG_CHIP_PW_RPC)
  include(${TELINK_COMMON}/Rpc.cmake)
endif(CONFIG_CHIP_PW_RPC)
```

## Kconfig
```
#
#    Copyright (c) 2023 Project CHIP Authors
#
#    Licensed under the Apache License, Version 2.0 (the "License");
#    you may not use this file except in compliance with the License.
#    You may obtain a copy of the License at
#
#        http://www.apache.org/licenses/LICENSE-2.0
#
#    Unless required by applicable law or agreed to in writing, software
#    distributed under the License is distributed on an "AS IS" BASIS,
#    WITHOUT WARRANTIES OR CONDITIONS OF ANY KIND, either express or implied.
#    See the License for the specific language governing permissions and
#    limitations under the License.
#
mainmenu "Matter Telink Lighting Example Application"

rsource "../../../config/telink/chip-module/Kconfig.defaults"
rsource "../../../config/telink/chip-module/MPKconfig.defaults"
source "Kconfig.zephyr"
```

## prj.conf
```kconfig
#
#    Copyright (c) 2021-2026 Project CHIP Authors
#
#    Licensed under the Apache License, Version 2.0 (the "License");
#    you may not use this file except in compliance with the License.
#    You may obtain a copy of the License at
#
#        http://www.apache.org/licenses/LICENSE-2.0
#
#    Unless required by applicable law or agreed to in writing, software
#    distributed under the License is distributed on an "AS IS" BASIS,
#    WITHOUT WARRANTIES OR CONDITIONS OF ANY KIND, either express or implied.
#    See the License for the specific language governing permissions and
#    limitations under the License.
#

# This sample uses Kconfig.defaults to set options common for all
# samples. This file should contain only options specific for this sample
# or overrides of default values.

# Enable CHIP
CONFIG_CHIP=y
CONFIG_STD_CPP20=y

# 32773 == 0x8005 (example lighting-app)
CONFIG_CHIP_DEVICE_PRODUCT_ID=32773

# Bluetooth Low Energy configuration
CONFIG_BT_DEVICE_NAME="TelinkLight"

# Disable Matter OTA DFU
CONFIG_CHIP_OTA_REQUESTOR=y
CONFIG_CHIP_DFU_OVER_BT_SMP=y
CONFIG_CHIP_DFU_OVER_BT_SMP_BUILD=y
CONFIG_CHIP_DEVICE_SOFTWARE_VERSION=1
CONFIG_TELINK_OTA_BUTTON_TEST=n

# Disable CHIP shell support
CONFIG_CHIP_LIB_SHELL=n

# Disable factory data support
CONFIG_CHIP_FACTORY_DATA=n
CONFIG_CHIP_FACTORY_DATA_BUILD=n
CONFIG_CHIP_FACTORY_DATA_MERGE_WITH_FIRMWARE=n
CONFIG_CHIP_CERTIFICATION_DECLARATION_STORAGE=n

# open seucre programming , need to open CONFIG_CHIP_FACTORY_DATA and CONFIG_CHIP_CERTIFICATION_DECLARATION_STORAGE
# init should be n
CONFIG_SECURE_PROGRAMMING=n

# Enable PWM
CONFIG_PWM=y
CONFIG_CHIP_DEVICE_DISCRIMINATOR=0xF00

# Enable Power Management
CONFIG_PM=n
# Enable ADC
CONFIG_ADC=y

# compress ota
CONFIG_COMPRESS_LZMA=n
CONFIG_LZMA=n

# matter switch mode
# config NORMAL_MODE    0 independent matter mode
# ACTION_DUAL_MODE      1 matter action switch mode ,such as by button
# AUTO_SWITCH_DUAL_MODE 2 matter auto-switch mode ,such as by scan QR code.should use 4m flash
CONFIG_DUAL_MODE=0

# Enable Independent Button
CONFIG_CHIP_BUTTON_MANAGER_IRQ_MODE=n

# Enable CHIP-ID via ble
CONFIG_EXPOSE_CHIP_ID_VIA_BLE=n

# Enable Deferred Store Attribute
CONFIG_DEFERRED_ATTR_STORAGE=n

# CONFIG_MCUBOOT_SIGNATURE_KEY_FILE="bootloader/mcuboot/ecdsa_private_key.pem"
```

## boards/tlsr9518adk80d.overlay
```dts
&pwm0 {
	status = "okay";
	clock-frequency = <93750>;
	// Use the following line for RGB PWM mode
	// pinctrl-0 = <&pwm_ch0_pb4_default &pwm_ch1_pb5_default &pwm_ch2_pb7_default>;
	pinctrl-0 = <&pwm_ch0_pb4_default>;
	pinctrl-names = "default";
};
```

## src/main.cpp
```c
/*
 *
 *    Copyright (c) 2023 Project CHIP Authors
 *    All rights reserved.
 *
 *    Licensed under the Apache License, Version 2.0 (the "License");
 *    you may not use this file except in compliance with the License.
 *    You may obtain a copy of the License at
 *
 *        http://www.apache.org/licenses/LICENSE-2.0
 *
 *    Unless required by applicable law or agreed to in writing, software
 *    distributed under the License is distributed on an "AS IS" BASIS,
 *    WITHOUT WARRANTIES OR CONDITIONS OF ANY KIND, either express or implied.
 *    See the License for the specific language governing permissions and
 *    limitations under the License.
 */

#include "AppTask.h"

#include <lib/support/CHIPMem.h>
#include <platform/CHIPDeviceLayer.h>

#include <zephyr/kernel.h>

#ifdef CONFIG_CHIP_PW_RPC
#include "Rpc.h"
#endif

LOG_MODULE_REGISTER(app, CONFIG_CHIP_APP_LOG_LEVEL);

using namespace ::chip;
using namespace ::chip::Inet;
using namespace ::chip::DeviceLayer;

int main(void)
{
    CHIP_ERROR err = CHIP_NO_ERROR;

#ifdef CONFIG_CHIP_PW_RPC
    rpc::Init();
#endif

    err = chip::Platform::MemoryInit();
    if (err != CHIP_NO_ERROR)
    {
        LOG_ERR("MemoryInit fail");
        goto exit;
    }

    err = PlatformMgr().InitChipStack();
    if (err != CHIP_NO_ERROR)
    {
        LOG_ERR("InitChipStack fail");
        goto exit;
    }

    err = PlatformMgr().StartEventLoopTask();
    if (err != CHIP_NO_ERROR)
    {
        LOG_ERR("StartEventLoopTask fail");
        goto exit;
    }

    err = ThreadStackMgr().InitThreadStack();
    if (err != CHIP_NO_ERROR)
    {
        LOG_ERR("InitThreadStack fail");
        goto exit;
    }

#ifdef CONFIG_OPENTHREAD_MTD_SED
    err = ConnectivityMgr().SetThreadDeviceType(ConnectivityManager::kThreadDeviceType_SleepyEndDevice);
#elif CONFIG_OPENTHREAD_MTD
    err = ConnectivityMgr().SetThreadDeviceType(ConnectivityManager::kThreadDeviceType_MinimalEndDevice);
#else
    err = ConnectivityMgr().SetThreadDeviceType(ConnectivityManager::kThreadDeviceType_Router);
#endif
    if (err != CHIP_NO_ERROR)
    {
        LOG_ERR("SetThreadDeviceType fail");
        goto exit;
    }

    err = GetAppTask().StartApp();

exit:
    LOG_ERR("Exit err %" CHIP_ERROR_FORMAT, err.Format());
    return (err == CHIP_NO_ERROR) ? EXIT_SUCCESS : EXIT_FAILURE;
}
```

## include/AppConfig.h
```c
/*
 *
 *    Copyright (c) 2021 Project CHIP Authors
 *    All rights reserved.
 *
 *    Licensed under the Apache License, Version 2.0 (the "License");
 *    you may not use this file except in compliance with the License.
 *    You may obtain a copy of the License at
 *
 *        http://www.apache.org/licenses/LICENSE-2.0
 *
 *    Unless required by applicable law or agreed to in writing, software
 *    distributed under the License is distributed on an "AS IS" BASIS,
 *    WITHOUT WARRANTIES OR CONDITIONS OF ANY KIND, either express or implied.
 *    See the License for the specific language governing permissions and
 *    limitations under the License.
 */

#pragma once

// ---- Lighting Example App Config ----

#define APP_SET_DEVICE_INFO_PROVIDER 1
#define APP_SET_NETWORK_COMM_ENDPOINT_SEC 0

// -----User setting part
#define APP_LIGHT_USER_MODE_EN 1

#define APP_LIGHT_PWM 0
#define APP_LIGHT_I2C 1
#define APP_LIGHT_ADC 2

#if CONFIG_I2C
#define APP_LIGHT_MODE APP_LIGHT_I2C
#elif CONFIG_ADC
#define APP_LIGHT_MODE APP_LIGHT_ADC
#else
#define APP_LIGHT_MODE APP_LIGHT_PWM
#endif

// Independent Factory Reset Button
#define INDEPENDENT_FACTORY_RESET_BUTTON 0

#define FW_TYPE_PRODUCT 0
#define FW_TYPE_DEBUG 1
#define FW_TYPE_DEVELOP 2

#define MATTER_FW_TYPE FW_TYPE_PRODUCT

#define APP_TELINK_DRIVERS_ADC 0
```

## include/AppEvent.h
```c
/*
 *
 *    Copyright (c) 2021 Project CHIP Authors
 *    All rights reserved.
 *
 *    Licensed under the Apache License, Version 2.0 (the "License");
 *    you may not use this file except in compliance with the License.
 *    You may obtain a copy of the License at
 *
 *        http://www.apache.org/licenses/LICENSE-2.0
 *
 *    Unless required by applicable law or agreed to in writing, software
 *    distributed under the License is distributed on an "AS IS" BASIS,
 *    WITHOUT WARRANTIES OR CONDITIONS OF ANY KIND, either express or implied.
 *    See the License for the specific language governing permissions and
 *    limitations under the License.
 */

#pragma once

#include <cstdint>

struct AppEvent;
typedef void (*EventHandler)(AppEvent *);

class LEDWidget;

struct AppEvent
{
    enum AppEventTypes
    {
        kEventType_Button = 0,
        kEventType_Timer,
        kEventType_UpdateLedState,
        kEventType_IdentifyStart,
        kEventType_IdentifyStop,
        kEventType_Lighting,
        kEventType_Install,
    };

    uint16_t Type;

    union
    {
        struct
        {
            uint8_t Action;
        } ButtonEvent;
        struct
        {
            void * Context;
        } TimerEvent;
        struct
        {
            uint8_t Action;
            int32_t Actor;
        } LightingEvent;
        struct
        {
            LEDWidget * LedWidget;
        } UpdateLedStateEvent;
    };

    EventHandler Handler;
};
```

## include/AppTask.h
```c
/*
 *
 *    Copyright (c) 2022-2023 Project CHIP Authors
 *    All rights reserved.
 *
 *    Licensed under the Apache License, Version 2.0 (the "License");
 *    you may not use this file except in compliance with the License.
 *    You may obtain a copy of the License at
 *
 *        http://www.apache.org/licenses/LICENSE-2.0
 *
 *    Unless required by applicable law or agreed to in writing, software
 *    distributed under the License is distributed on an "AS IS" BASIS,
 *    WITHOUT WARRANTIES OR CONDITIONS OF ANY KIND, either express or implied.
 *    See the License for the specific language governing permissions and
 *    limitations under the License.
 */

#pragma once

#include "AppTaskCommon.h"

class AppTask : public AppTaskCommon
{
public:
    enum Fixture_Action : uint8_t
    {
        ON_ACTION = 0,
        OFF_ACTION,
        LEVEL_ACTION,
        COLOR_ACTION_XY,
        COLOR_ACTION_HSV,
        COLOR_ACTION_CT,

        INVALID_ACTION
    };

#ifdef CONFIG_CHIP_ENABLE_POWER_ON_FACTORY_RESET
    void PowerOnFactoryReset(void);
#endif /* CONFIG_CHIP_ENABLE_POWER_ON_FACTORY_RESET */

    bool IsTurnedOn() const;
    void SetInitiateAction(Fixture_Action aAction, int32_t aActor, uint8_t * value);
    void UpdateClusterState(void);
    void Init_cluster_info(void);
    void Set_cluster_info(void);

private:
    friend AppTask & GetAppTask(void);
    friend class AppTaskCommon;

    CHIP_ERROR Init(void);
    void LinkLeds(LedManager & ledManager);

    static void LightingActionEventHandler(AppEvent * aEvent);
#ifdef CONFIG_CHIP_ENABLE_POWER_ON_FACTORY_RESET
    static void PowerOnFactoryResetEventHandler(AppEvent * aEvent);
    static void PowerOnFactoryResetTimerEvent(struct k_timer * dummy);

    static unsigned int sPowerOnFactoryResetTimerCnt;
    static k_timer sPowerOnFactoryResetTimer;
#endif /* CONFIG_CHIP_ENABLE_POWER_ON_FACTORY_RESET */

    static AppTask sAppTask;
};

inline AppTask & GetAppTask(void)
{
    return AppTask::sAppTask;
}
```

## include/CHIPProjectConfig.h
```c
/*
 *
 *    Copyright (c) 2021 Project CHIP Authors
 *    All rights reserved.
 *
 *    Licensed under the Apache License, Version 2.0 (the "License");
 *    you may not use this file except in compliance with the License.
 *    You may obtain a copy of the License at
 *
 *        http://www.apache.org/licenses/LICENSE-2.0
 *
 *    Unless required by applicable law or agreed to in writing, software
 *    distributed under the License is distributed on an "AS IS" BASIS,
 *    WITHOUT WARRANTIES OR CONDITIONS OF ANY KIND, either express or implied.
 *    See the License for the specific language governing permissions and
 *    limitations under the License.
 */

/**
 *    @file
 *          Example project configuration file for CHIP.
 *
 *          This is a place to put application or project-specific overrides
 *          to the default configuration values for general CHIP features.
 *
 */

#pragma once

// Use a default pairing code if one hasn't been provisioned in flash.
#define CHIP_DEVICE_CONFIG_USE_TEST_SETUP_PIN_CODE 20202021
#define CHIP_DEVICE_CONFIG_USE_TEST_SETUP_DISCRIMINATOR 0xF02

//  Switching from Thread child to router may cause a few second packet stall.
//  Until this is improved in OpenThread we need to increase the retransmission
//  interval to survive the stall.
#define CHIP_CONFIG_MRP_LOCAL_ACTIVE_RETRY_INTERVAL (1000_ms32)

// ========== Multicast groups Configuration Overrides =========
#undef CHIP_CONFIG_MAX_GROUP_ENDPOINTS_PER_FABRIC
#define CHIP_CONFIG_MAX_GROUP_ENDPOINTS_PER_FABRIC 2

#define CHIP_CONFIG_EXAMPLE_ACCESS_CONTROL_MAX_SUBJECTS_PER_ENTRY (4 * CHIP_CONFIG_MAX_GROUP_ENDPOINTS_PER_FABRIC)
```

## src/ZclCallbacks.cpp
```c
/*
 *
 *    Copyright (c) 2022-2024 Project CHIP Authors
 *    All rights reserved.
 *
 *    Licensed under the Apache License, Version 2.0 (the "License");
 *    you may not use this file except in compliance with the License.
 *    You may obtain a copy of the License at
 *
 *        http://www.apache.org/licenses/LICENSE-2.0
 *
 *    Unless required by applicable law or agreed to in writing, software
 *    distributed under the License is distributed on an "AS IS" BASIS,
 *    WITHOUT WARRANTIES OR CONDITIONS OF ANY KIND, either express or implied.
 *    See the License for the specific language governing permissions and
 *    limitations under the License.
 */

#include "AppConfig.h"
#include "AppTask.h"
#include "ColorFormat.h"

#include <app-common/zap-generated/attributes/Accessors.h>
#include <app-common/zap-generated/ids/Attributes.h>
#include <app-common/zap-generated/ids/Clusters.h>
#include <app/ConcreteAttributePath.h>
#include <lib/support/logging/CHIPLogging.h>

LOG_MODULE_DECLARE(app, CONFIG_CHIP_APP_LOG_LEVEL);

using namespace chip;
using namespace chip::app::Clusters;

#if APP_LIGHT_USER_MODE_EN

#if CONFIG_STARTUP_OPTIMIZATE
#include "AppTaskCommon.h"

static uint8_t latest_level;
#define CLUTER_SOTRE_TIMEOUT 500
#define TRANSTION_TIMER_INIT_FLAG 0x55
#define TRANSTION_TIMER_DEINIT_FLAG 0x00

struct k_timer LevelChangeTimer;
static int timer_period   = CLUTER_SOTRE_TIMEOUT;
static uint8_t init_timer = TRANSTION_TIMER_INIT_FLAG;

static void LevelTimeoutCallback(struct k_timer * timer)
{
    if (!timer)
    {
        return;
    }

    cluster_startup_para *p_para = &g_light_cluster_para;

    if (p_para->currentLevel != latest_level)
    {
        p_para->preCurrentLevel = p_para->currentLevel;
        p_para->currentLevel    = latest_level;
        printk("[LevelTimeoutCallback] currentLevel=%d\n", p_para->currentLevel);
        if (store_cluster_para(p_para) != 0)
        {
            printk("[LevelTimeoutCallback] Fail store startup cluster para\n");
        }
    }
}

void MatterPostAttributeChangeCallback(const chip::app::ConcreteAttributePath & attributePath, uint8_t type, uint16_t size,
                                       uint8_t * value)
{
    /* user mode , add the customer code here for cb*/
    ClusterId clusterId     = attributePath.mClusterId;
    AttributeId attributeId = attributePath.mAttributeId;

    if (init_timer == TRANSTION_TIMER_INIT_FLAG)
    {
        k_timer_init(&LevelChangeTimer, &LevelTimeoutCallback, nullptr);
        init_timer = TRANSTION_TIMER_DEINIT_FLAG;
    }

    Protocols::InteractionModel::Status status;
    Clusters::ColorControl::ColorModeEnum tmpColorMode;
    Clusters::ColorControl::EnhancedColorModeEnum tmpEnhancedColorMode;
    cluster_startup_para * p_para = &g_light_cluster_para;
    if (clusterId == OnOff::Id)
    {
        if (attributeId == OnOff::Attributes::OnOff::Id)
        {
            uint8_t tmp = *value;
            if (p_para->onOff != tmp)
            {
                p_para->onOff = tmp;
                printk("[clusterId:OnOff] OnOff=%d\n", p_para->onOff);

                if (store_cluster_para(p_para) != 0)
                {
                    printk("[clusterId:OnOff] Fail store startup cluster para\n");
                }
            }
        }
        else if (attributeId == OnOff::Attributes::StartUpOnOff::Id)
        {
            uint8_t tmp = *value;
            DataModel::Nullable<chip::app::Clusters::OnOff::StartUpOnOffEnum> tmp1 =
                (chip::app::Clusters::OnOff::StartUpOnOffEnum) tmp;
            if (tmp1.IsNull())
            {
                tmp = 0xff;
            }
            if (p_para->startUpOnOff != tmp)
            {
                p_para->startUpOnOff = tmp;
                printk("[clusterId:OnOff] StartUpOnOff=%d\n", p_para->startUpOnOff);
                if (store_cluster_para(p_para) != 0)
                {
                    printk("[clusterId:OnOff] Fail store startup cluster para\n");
                }
            }
        }
    }
    else if (clusterId == LevelControl::Id)
    {
        if (attributeId == LevelControl::Attributes::CurrentLevel::Id)
        {
            latest_level = *value;
            k_timer_stop(&LevelChangeTimer);
            k_timer_start(&LevelChangeTimer, K_MSEC(timer_period), K_NO_WAIT);
        }
        else if (attributeId == LevelControl::Attributes::MinLevel::Id)
        {
            uint8_t tmp = *value;
            if (p_para->minLevel != tmp)
            {
                p_para->minLevel = tmp;
                printk("[clusterId:LevelControl] MinLevel=%d\n", p_para->minLevel);
                if (store_cluster_para(p_para) != 0)
                {
                    printk("[clusterId:OnOff] Fail store startup cluster para\n");
                }
            }
        }
        else if (attributeId == LevelControl::Attributes::MaxLevel::Id)
        {
            uint8_t tmp = *value;
            if (p_para->maxLevel != tmp)
            {
                p_para->maxLevel = tmp;
                printk("[clusterId:LevelControl] MaxLevel=%d\n", p_para->maxLevel);
                if (store_cluster_para(p_para) != 0)
                {
                    printk("[clusterId:OnOff] Fail store startup cluster para\n");
                }
            }
        }
        else if (attributeId == LevelControl::Attributes::StartUpCurrentLevel::Id)
        {
            uint8_t tmp             = *value;
            p_para->preCurrentLevel = p_para->currentLevel;

            DataModel::Nullable<uint8_t> tmp1 = tmp;
            if (tmp1.IsNull())
            {
                tmp = 0xff;
            }
            p_para->startUpCurrentLevel = tmp;
            printk("[clusterId:LevelControl] StartUpCurrentLevel=%d\n", p_para->startUpCurrentLevel);
            if (store_cluster_para(p_para) != 0)
            {
                printk("[clusterId:OnOff] Fail store startup cluster para\n");
            }
        }
    }
    else if (clusterId == ColorControl::Id)
    {
        if (attributeId == ColorControl::Attributes::CurrentHue::Id)
        {
            uint8_t tmp = *value;
            status      = Clusters::ColorControl::Attributes::ColorMode::Get(1, &tmpColorMode);
            p_para->colorMode = static_cast<uint8_t>(tmpColorMode);
            status      = Clusters::ColorControl::Attributes::EnhancedColorMode::Get(1, &tmpEnhancedColorMode);
            p_para->enhancedColorMode = static_cast<uint8_t>(tmpEnhancedColorMode);

            p_para->hsv.h = tmp;
            printk("[clusterId:ColorControl] CurrentHue=%d\n", p_para->hsv.h);
            printk("[clusterId:ColorControl] ColorMode=%d\n", p_para->colorMode);
            printk("[clusterId:ColorControl] EnhancedColorMode=%d\n", p_para->enhancedColorMode);
            if (store_cluster_para(p_para) != 0)
            {
                printk("[clusterId:OnOff] Fail store startup cluster para\n");
            }
        }
        else if (attributeId == ColorControl::Attributes::CurrentSaturation::Id)
        {
            uint8_t tmp = *value;
            status      = Clusters::ColorControl::Attributes::ColorMode::Get(1, &tmpColorMode);
            p_para->colorMode = static_cast<uint8_t>(tmpColorMode);
            status      = Clusters::ColorControl::Attributes::EnhancedColorMode::Get(1, &tmpEnhancedColorMode);
            p_para->enhancedColorMode = static_cast<uint8_t>(tmpEnhancedColorMode);

            p_para->hsv.s = tmp;
            printk("[clusterId:ColorControl] CurrentSaturation=%d\n", p_para->hsv.s);
            printk("[clusterId:ColorControl] ColorMode=%d\n", p_para->colorMode);
            printk("[clusterId:ColorControl] EnhancedColorMode=%d\n", p_para->enhancedColorMode);
            if (store_cluster_para(p_para) != 0)
            {
                printk("[clusterId:OnOff] Fail store startup cluster para\n");
            }
        }
        else if (attributeId == ColorControl::Attributes::CurrentX::Id)
        {
            uint16_t tmp = *reinterpret_cast<uint16_t *>(value);
            status       = Clusters::ColorControl::Attributes::ColorMode::Get(1, &tmpColorMode);
            p_para->colorMode = static_cast<uint8_t>(tmpColorMode);
            status       = Clusters::ColorControl::Attributes::EnhancedColorMode::Get(1, &tmpEnhancedColorMode);
            p_para->enhancedColorMode = static_cast<uint8_t>(tmpEnhancedColorMode);

            p_para->xy.x = tmp;
            printk("[clusterId:ColorControl] CurrentX=%d\n", p_para->xy.x);
            printk("[clusterId:ColorControl] ColorMode=%d\n", p_para->colorMode);
            printk("[clusterId:ColorControl] EnhancedColorMode=%d\n", p_para->enhancedColorMode);
            if (store_cluster_para(p_para) != 0)
            {
                printk("[clusterId:OnOff] Fail store startup cluster para\n");
            }
        }
        else if (attributeId == ColorControl::Attributes::CurrentY::Id)
        {

            uint16_t tmp = *reinterpret_cast<uint16_t *>(value);
            status       = Clusters::ColorControl::Attributes::ColorMode::Get(1, &tmpColorMode);
            p_para->colorMode = static_cast<uint8_t>(tmpColorMode);
            status       = Clusters::ColorControl::Attributes::EnhancedColorMode::Get(1, &tmpEnhancedColorMode);
            p_para->enhancedColorMode = static_cast<uint8_t>(tmpEnhancedColorMode);

            p_para->xy.y = tmp;
            printk("[clusterId:ColorControl] CurrentX=%d\n", p_para->xy.x);
            printk("[clusterId:ColorControl] ColorMode=%d\n", p_para->colorMode);
            printk("[clusterId:ColorControl] EnhancedColorMode=%d\n", p_para->enhancedColorMode);
            if (store_cluster_para(p_para) != 0)
            {
                printk("[clusterId:OnOff] Fail store startup cluster para\n");
            }
        }
        else if (attributeId == ColorControl::Attributes::ColorTemperatureMireds::Id)
        {
            uint16_t tmp = *reinterpret_cast<uint16_t *>(value);
            status       = Clusters::ColorControl::Attributes::ColorMode::Get(1, &tmpColorMode);
            p_para->colorMode = static_cast<uint8_t>(tmpColorMode);
            status       = Clusters::ColorControl::Attributes::EnhancedColorMode::Get(1, &tmpEnhancedColorMode);
            p_para->enhancedColorMode = static_cast<uint8_t>(tmpEnhancedColorMode);

            p_para->colorTemperatureMireds = tmp;
            printk("[clusterId:ColorControl] ColorTemperatureMireds=%d\n", p_para->colorTemperatureMireds);
            printk("[clusterId:ColorControl] ColorMode=%d\n", p_para->colorMode);
            printk("[clusterId:ColorControl] EnhancedColorMode=%d\n", p_para->enhancedColorMode);
            if (store_cluster_para(p_para) != 0)
            {
                printk("[clusterId:OnOff] Fail store startup cluster para\n");
            }
        }
        else if (attributeId == ColorControl::Attributes::ColorMode::Id)
        {
            uint8_t tmp = *value;
            printk("[clusterId:ColorControl] ColorMode=%d\n", p_para->colorMode);
            if (p_para->colorMode != tmp)
            {
                p_para->colorMode = tmp;
                if (store_cluster_para(p_para) != 0)
                {
                    printk("[clusterId:OnOff] Fail store startup cluster para\n");
                }
            }
        }
        else if (attributeId == ColorControl::Attributes::EnhancedCurrentHue::Id)
        {
            uint16_t tmp = *reinterpret_cast<uint16_t *>(value);
            status       = Clusters::ColorControl::Attributes::ColorMode::Get(1, &tmpColorMode);
            p_para->colorMode = static_cast<uint8_t>(tmpColorMode);
            status       = Clusters::ColorControl::Attributes::EnhancedColorMode::Get(1, &tmpEnhancedColorMode);
            p_para->enhancedColorMode = static_cast<uint8_t>(tmpEnhancedColorMode);

            p_para->enhancedCurrentHue = tmp;
            printk("[clusterId:ColorControl] EnhancedCurrentHue=%d\n", p_para->enhancedCurrentHue);
            printk("[clusterId:ColorControl] ColorMode=%d\n", p_para->colorMode);
            printk("[clusterId:ColorControl] EnhancedColorMode=%d\n", p_para->enhancedColorMode);
            if (store_cluster_para(p_para) != 0)
            {
                printk("[clusterId:OnOff] Fail store startup cluster para\n");
            }
        }
        else if (attributeId == ColorControl::Attributes::EnhancedColorMode::Id)
        {
            uint8_t tmp = *value;
            printk("[clusterId:ColorControl] EnhancedColorMode=%d\n", p_para->enhancedColorMode);
            if (p_para->enhancedColorMode != tmp)
            {
                p_para->enhancedColorMode = tmp;
                if (store_cluster_para(p_para) != 0)
                {
                    printk("[clusterId:OnOff] Fail store startup cluster para\n");
                }
            }
        }
        else if (attributeId == ColorControl::Attributes::StartUpColorTemperatureMireds::Id)
        {
            uint16_t tmp                       = *reinterpret_cast<uint16_t *>(value);
            DataModel::Nullable<uint16_t> tmp1 = tmp;
            if (tmp1.IsNull())
            {
                tmp = 0xffff;
            }
            status = Clusters::ColorControl::Attributes::ColorMode::Get(1, &tmpColorMode);
            p_para->colorMode = static_cast<uint8_t>(tmpColorMode);
            status = Clusters::ColorControl::Attributes::EnhancedColorMode::Get(1, &tmpEnhancedColorMode);
            p_para->enhancedColorMode = static_cast<uint8_t>(tmpEnhancedColorMode);

            if (p_para->startUpColorTemperatureMireds != tmp)
            {
                p_para->startUpColorTemperatureMireds = tmp;
                if (store_cluster_para(p_para) != 0)
                {
                    printk("[clusterId:OnOff] Fail store startup cluster para\n");
                }
            }
        }
    }
}
#else
void MatterPostAttributeChangeCallback(const chip::app::ConcreteAttributePath & attributePath, uint8_t type, uint16_t size,
                                       uint8_t * value)
{
    /* user mode, add the customer code here for cb*/
    return;
}
#endif /* CONFIG_STARTUP_OPTIMIZATE */

#else
void MatterPostAttributeChangeCallback(const chip::app::ConcreteAttributePath & attributePath, uint8_t type, uint16_t size,
                                       uint8_t * value)
{
    static HsvColor_t hsv;
    static XyColor_t xy;
    ClusterId clusterId     = attributePath.mClusterId;
    AttributeId attributeId = attributePath.mAttributeId;

    if (clusterId == OnOff::Id && attributeId == OnOff::Attributes::OnOff::Id)
    {
        ChipLogDetail(Zcl, "Cluster OnOff: attribute OnOff set to %u", *value);
        GetAppTask().SetInitiateAction(*value ? AppTask::ON_ACTION : AppTask::OFF_ACTION,
                                       static_cast<int32_t>(AppEvent::kEventType_DeviceAction), value);
    }
    else if (clusterId == LevelControl::Id && attributeId == LevelControl::Attributes::CurrentLevel::Id)
    {
        if (GetAppTask().IsTurnedOn())
        {
            ChipLogDetail(Zcl, "Cluster LevelControl: attribute CurrentLevel set to %u", *value);
            GetAppTask().SetInitiateAction(AppTask::LEVEL_ACTION, static_cast<int32_t>(AppEvent::kEventType_DeviceAction), value);
        }
        else
        {
            ChipLogDetail(Zcl, "LED is off. Try to use move-to-level-with-on-off instead of move-to-level");
        }
    }
    else if (clusterId == ColorControl::Id)
    {
        /* Ignore several attributes that are currently not processed */
        if ((attributeId == ColorControl::Attributes::RemainingTime::Id) ||
            (attributeId == ColorControl::Attributes::EnhancedColorMode::Id) ||
            (attributeId == ColorControl::Attributes::ColorMode::Id))
        {
            return;
        }

        /* XY color space */
        if (attributeId == ColorControl::Attributes::CurrentX::Id || attributeId == ColorControl::Attributes::CurrentY::Id)
        {
            if (attributeId == ColorControl::Attributes::CurrentX::Id)
            {
                xy.x = *reinterpret_cast<uint16_t *>(value);
            }
            else if (attributeId == ColorControl::Attributes::CurrentY::Id)
            {
                xy.y = *reinterpret_cast<uint16_t *>(value);
            }

            ChipLogDetail(Zcl, "New XY color: %u|%u", xy.x, xy.y);
            GetAppTask().SetInitiateAction(AppTask::COLOR_ACTION_XY, static_cast<int32_t>(AppEvent::kEventType_DeviceAction),
                                           (uint8_t *) &xy);
        }
        /* HSV color space */
        else if (attributeId == ColorControl::Attributes::CurrentHue::Id ||
                 attributeId == ColorControl::Attributes::CurrentSaturation::Id ||
                 attributeId == ColorControl::Attributes::EnhancedCurrentHue::Id)
        {
            if (attributeId == ColorControl::Attributes::EnhancedCurrentHue::Id)
            {
                hsv.h = (uint8_t) (((*reinterpret_cast<uint16_t *>(value)) & 0xFF00) >> 8);
                hsv.s = (uint8_t) ((*reinterpret_cast<uint16_t *>(value)) & 0xFF);
            }
            else if (attributeId == ColorControl::Attributes::CurrentHue::Id)
            {
                hsv.h = *value;
            }
            else if (attributeId == ColorControl::Attributes::CurrentSaturation::Id)
            {
                hsv.s = *value;
            }
            ChipLogDetail(Zcl, "New HSV color: hue = %u| saturation = %u", hsv.h, hsv.s);
            GetAppTask().SetInitiateAction(AppTask::COLOR_ACTION_HSV, static_cast<int32_t>(AppEvent::kEventType_DeviceAction),
                                           (uint8_t *) &hsv);
        }
        /* Temperature Mireds color space */
        else if (attributeId == ColorControl::Attributes::ColorTemperatureMireds::Id)
        {
            ChipLogDetail(Zcl, "New Temperature Mireds color = %u", *(uint16_t *) value);
            GetAppTask().SetInitiateAction(AppTask::COLOR_ACTION_CT, static_cast<int32_t>(AppEvent::kEventType_DeviceAction),
                                           value);
        }
        else
        {
            ChipLogDetail(Zcl, "Ignore ColorControl attribute (%u) that is not currently processed!", attributeId);
        }
    }
}
#endif /* APP_LIGHT_USER_MODE_EN */
```

## src/electrical-energy-measurement.cpp
```c
/*
 *
 *    Copyright (c) 2023 Project CHIP Authors
 *    All rights reserved.
 *
 *    Licensed under the Apache License, Version 2.0 (the "License");
 *    you may not use this file except in compliance with the License.
 *    You may obtain a copy of the License at
 *
 *        http://www.apache.org/licenses/LICENSE-2.0
 *
 *    Unless required by applicable law or agreed to in writing, software
 *    distributed under the License is distributed on an "AS IS" BASIS,
 *    WITHOUT WARRANTIES OR CONDITIONS OF ANY KIND, either express or implied.
 *    See the License for the specific language governing permissions and
 *    limitations under the License.
 */

#include <app/clusters/electrical-energy-measurement-server/electrical-energy-measurement-server.h>

using namespace chip;
using namespace chip::app::Clusters;
using namespace chip::app::Clusters::ElectricalEnergyMeasurement;
using namespace chip::app::Clusters::ElectricalEnergyMeasurement::Structs;

static std::unique_ptr<ElectricalEnergyMeasurementAttrAccess> gAttrAccess;

void emberAfElectricalEnergyMeasurementClusterInitCallback(chip::EndpointId endpointId)
{
    ChipLogProgress(DataManagement, "XXX UTCSH-429 LOG -> emberAfElectricalEnergyMeasurementClusterInitCallback: endpointId = 0x%x", endpointId);

    VerifyOrDie(endpointId == 1); // this cluster is only enabled for endpoint 1.
    VerifyOrDie(!gAttrAccess);

    gAttrAccess = std::make_unique<ElectricalEnergyMeasurementAttrAccess>(
        BitMask<Feature, uint32_t>(Feature::kImportedEnergy, Feature::kExportedEnergy, Feature::kCumulativeEnergy,
                                   Feature::kPeriodicEnergy),
        BitMask<OptionalAttributes, uint32_t>(OptionalAttributes::kOptionalAttributeCumulativeEnergyReset));

    if (gAttrAccess)
    {
        gAttrAccess->Init();
    }
}
```

## src/electrical-power-measurement.cpp
```c
/*
 *
 *    Copyright (c) 2023 Project CHIP Authors
 *    All rights reserved.
 *
 *    Licensed under the Apache License, Version 2.0 (the "License");
 *    you may not use this file except in compliance with the License.
 *    You may obtain a copy of the License at
 *
 *        http://www.apache.org/licenses/LICENSE-2.0
 *
 *    Unless required by applicable law or agreed to in writing, software
 *    distributed under the License is distributed on an "AS IS" BASIS,
 *    WITHOUT WARRANTIES OR CONDITIONS OF ANY KIND, either express or implied.
 *    See the License for the specific language governing permissions and
 *    limitations under the License.
 */

#include <ElectricalPowerMeasurementDelegate.h>

using namespace chip;
using namespace chip::app::Clusters;
using namespace chip::app::Clusters::ElectricalPowerMeasurement;

static std::unique_ptr<ElectricalPowerMeasurementDelegate> gEPMDelegate;
static std::unique_ptr<ElectricalPowerMeasurementInstance> gEPMInstance;

void emberAfElectricalPowerMeasurementClusterInitCallback(chip::EndpointId endpointId)
{
    ChipLogProgress(DataManagement, "XXX UTCSH-429 LOG -> emberAfElectricalPowerMeasurementClusterInitCallback: endpointId= 0x%x", endpointId);

    VerifyOrDie(endpointId == 1); // this cluster is only enabled for endpoint 1.
    VerifyOrDie(!gEPMInstance);

    gEPMDelegate = std::make_unique<ElectricalPowerMeasurementDelegate>();
    if (gEPMDelegate)
    {
        gEPMInstance = std::make_unique<ElectricalPowerMeasurementInstance>(
            endpointId, *gEPMDelegate,
            BitMask<Feature, uint32_t>(Feature::kDirectCurrent, Feature::kAlternatingCurrent, Feature::kPolyphasePower,
                                       Feature::kHarmonics, Feature::kPowerQuality),
            BitMask<OptionalAttributes, uint32_t>(
                OptionalAttributes::kOptionalAttributeRanges, OptionalAttributes::kOptionalAttributeVoltage,
                OptionalAttributes::kOptionalAttributeActiveCurrent, OptionalAttributes::kOptionalAttributeReactiveCurrent,
                OptionalAttributes::kOptionalAttributeApparentCurrent, OptionalAttributes::kOptionalAttributeReactivePower,
                OptionalAttributes::kOptionalAttributeApparentPower, OptionalAttributes::kOptionalAttributeRMSVoltage,
                OptionalAttributes::kOptionalAttributeRMSCurrent, OptionalAttributes::kOptionalAttributeRMSPower,
                OptionalAttributes::kOptionalAttributeFrequency, OptionalAttributes::kOptionalAttributePowerFactor,
                OptionalAttributes::kOptionalAttributeNeutralCurrent));

        gEPMInstance->Init();

        gEPMDelegate->SetPowerMode(PowerModeEnum::kAc);
    }
}
```

## src/power-topology.cpp
```c
/*
 *
 *    Copyright (c) 2024 Project CHIP Authors
 *    All rights reserved.
 *
 *    Licensed under the Apache License, Version 2.0 (the "License");
 *    you may not use this file except in compliance with the License.
 *    You may obtain a copy of the License at
 *
 *        http://www.apache.org/licenses/LICENSE-2.0
 *
 *    Unless required by applicable law or agreed to in writing, software
 *    distributed under the License is distributed on an "AS IS" BASIS,
 *    WITHOUT WARRANTIES OR CONDITIONS OF ANY KIND, either express or implied.
 *    See the License for the specific language governing permissions and
 *    limitations under the License.
 */

#include <app/clusters/power-topology-server/power-topology-server.h>

using namespace chip;
using namespace chip::app::Clusters;
using namespace chip::app::Clusters::PowerTopology;

namespace chip {
namespace app {
namespace Clusters {
namespace PowerTopology {

class PowerTopologyDelegate : public Delegate
{
public:
    ~PowerTopologyDelegate() = default;

    CHIP_ERROR GetAvailableEndpointAtIndex(size_t index, EndpointId & endpointId) override;
    CHIP_ERROR GetActiveEndpointAtIndex(size_t index, EndpointId & endpointId) override;
};

CHIP_ERROR PowerTopologyDelegate::GetAvailableEndpointAtIndex(size_t index, EndpointId & endpointId)
{
    return CHIP_ERROR_PROVIDER_LIST_EXHAUSTED;
}

CHIP_ERROR PowerTopologyDelegate::GetActiveEndpointAtIndex(size_t index, EndpointId & endpointId)
{
    return CHIP_ERROR_PROVIDER_LIST_EXHAUSTED;
}

} // namespace PowerTopology
} // namespace Clusters
} // namespace app
} // namespace chip

static std::unique_ptr<PowerTopology::Delegate> gDelegate;
static std::unique_ptr<PowerTopology::Instance> gInstance;

void emberAfPowerTopologyClusterInitCallback(chip::EndpointId endpointId)
{
    ChipLogProgress(DataManagement, "XXX UTCSH-429 LOG -> emberAfPowerTopologyClusterInitCallback: endpointId= 0x%x", endpointId);

    VerifyOrDie(endpointId == 1); // this cluster is only enabled for endpoint 1.
    VerifyOrDie(!gInstance);

    gDelegate = std::make_unique<PowerTopologyDelegate>();
    if (gDelegate)
    {
        gInstance = std::make_unique<Instance>(
            endpointId, *gDelegate, BitMask<Feature, uint32_t>(Feature::kSetTopology, Feature::kDynamicPowerFlow),
            BitMask<OptionalAttributes, uint32_t>(OptionalAttributes::kOptionalAttributeAvailableEndpoints,
                                                  OptionalAttributes::kOptionalAttributeActiveEndpoints));

        gInstance->Init();
    }
}
```
